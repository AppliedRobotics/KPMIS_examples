#include "Servo.h"

static byte servo_pins[5] = {8, 9, 10, 11, 12}; //пины сервоприводов
static int potent_pins[5] = {A10, A11, A12, A13, A14}; //пины потенциометров
static byte limits[5][2] = {
                            {20, 180}, //servo 1
                            {40, 150}, 
                            {20, 80},   
                            {10, 180},
                            {10, 90}    //servo 5
                           }; //Границы действия для сервоприводов. первое число - min, второе - max. Задано в виде многомерного массива.

Servo servo[5]; //обьявляем пять сервоприводов

void setup() {
  for (int i = 0; i < 5; i++) {
  pinMode(potent_pins[i], INPUT); //Инициализация всех потенциометров с цикле
  servo[i].attach(servo_pins[i]); //Инициализация всех сервоприводов в цикле
  }

}

/**
 * Функция чтения показаний потенциометра, 
 * приведённых к диапазону работы сервопривода
 * Pin - Пин потенциометра
 * Min - Минимальное значение для сервопривода
 * Max - Максимальное значение для сервопривода
 */
int readPot(int Pin, int Min, int Max) {
  int value = analogRead(Pin)/4;//Считываем показания потенциометра и делим на 4, сужая диапазон значений потенциометра до диапазона сервопривода
  if (value > Max) {
      value = Max;//Данной проверкой выставляем максимальное значение для value.
  }
  if (value < Min) {
      value = Min;//Данной проверкой выставляем минимальное значение для value.
  }
  return value; //возвращаем значение на точку вызова функции.
}
/** 
 * void loop: Основной цикл программы.
 * Так как у нас каждому сервоприводу соответствует свой потенциометр а также границы действия,
 * в цикле для каждого сервопривода читаем значения потенциометра в функции readPot, учитывающей
 * границы действия каждого сервопривода - и присваиваем данные значения сервоприводам, заставляя их передвигаться
 */
void loop() {
  for (int i = 0; i < 5; i++) {
        byte pos = readPot(potent_pins[i], limits[i][0], limits[i][1]);
        servo[i].write(pos);
  }
  delay(10);
}
